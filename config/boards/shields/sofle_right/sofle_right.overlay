#include <dt-bindings/i2c/i2c.h>

// Añadir trackball al bus I2C existente (que ya usa OLED)
&pro_micro_i2c {
    trackball: trackball@0a {
        compatible = "pimoroni,pim447";
        reg = <0x0a>;
        status = "okay";
    };
};

&chosen { 
    zmk,pointing-device = &trackball; 
};