#include <dt-bindings/i2c/i2c.h>

// Minimal I2C configuration for trackball testing
&i2c0 {
    status = "okay";
    clock-frequency = <I2C_BITRATE_STANDARD>; // 100 kHz for reliability
    
    trackball: trackball@0a {
        compatible = "pimoroni,trackball";
        reg = <0x0a>;
        status = "okay";
    };
};

&chosen {
    zmk,pointing-device = &trackball;
};