## config/west.yml
```yaml
manifest:
  remotes:
    - name: zmkfirmware
      url-base: https://github.com/zmkfirmware
    - name: cdc-mkb
      url-base: https://github.com/cdc-mkb
  projects:
    - name: zmk
      remote: cdc-mkb
      revision: main
      import: app/west.yml
  self:
    path: config
```

## config/zmk/app/dts/bindings/sensor/pimoroni,trackball_pim447.yaml
```yaml
description: Pimoroni PIM447 Trackball

compatible: "pimoroni,trackball_pim447"

include: i2c-device.yaml

properties:
  reg:
    required: true
  mode:
    type: int
    required: false
    description: >
      Operating mode of the trackball:
      0 = pointer (PIM447_MOVE), 1 = scroll (PIM447_SCROLL)
    enum:
      - 0
      - 1
  move-factor:
    type: int
    description: Pointer velocity multiplier (default: 1)
  scroll-divisor:
    type: int
    description: Scroll velocity divisor (default: 2)
  invert-move-x:
    type: boolean
  invert-move-y:
    type: boolean
  invert-scroll-x:
    type: boolean
  invert-scroll-y:
    type: boolean
  swap-axes:
    type: boolean
  button:
    type: int
    description: Mouse button sent when pressing the ball (0=left, 1=right)
```

## kconfig_patch/Kconfig
```kconfig
menu "Local Kconfig patches"
config ZMK_KSCAN_DIRECT_POLLING
    bool "Placeholder to satisfy Kconfig (upstream shield quirk)"
    default n

config ZMK_SHORT_DEVICE_NAMES
    bool "Use short device names for behaviors"
    default y
    help
      Use synthetic short names for ZMK behavior devices to avoid
      Zephyr's 48-character device name limit. Safe for behaviors
      as they are not real hardware devices.
endmenu
```

## modules/trackball_pim447/Kconfig
```kconfig
menu "PIM447 trackball"

config ZMK_TRACKBALL_PIM447
	bool "Enable Pimoroni PIM447 trackball"
	depends on I2C && ZMK_MOUSE
	select SENSOR
	help
	  Enables support for the Pimoroni PIM447 I2C trackball.

endmenu
```

## modules/trackball_pim447/dts/bindings/sensor/pimoroni,pim447-trackball.yaml
```yaml
# SPDX-License-Identifier: MIT
title: Pimoroni PIM447 I2C Trackball

description: >
  Pimoroni PIM447 trackball over I2C.

compatible: "pimoroni,pim447-trackball"

include: i2c-device.yaml

properties:
  reg:
    required: true
```

## patches/Kconfig
```kconfig
config PATCHES_AUTOMOUSE
    bool "Enable automouse layer support for PIM447"
    default y
    help
      Provides activate_automouse_layer function for PIM447 trackball driver
```

## patches/dts/bindings/i2c/pimoroni,pim447.yaml
```yaml
description: Pimoroni PIM447 trackball I2C device
compatible: "pimoroni,pim447"
include: i2c-device.yaml

properties:
  reg:
    required: true
    
  int-gpios:
    type: phandle-array
    required: false
    description: GPIO pin for interrupt signal
    
  reset-gpios:
    type: phandle-array
    required: false
    description: GPIO pin for reset signal
```

## patches/dts/bindings/i2c/zmk,pimoroni-pim447.yaml
```yaml
description: ZMK Pimoroni PIM447 trackball I2C device
compatible: "zmk,pimoroni-pim447"
include: i2c-device.yaml

properties:
  reg:
    required: true
    
  int-gpios:
    type: phandle-array
    required: false
    description: GPIO pin for interrupt signal
    
  reset-gpios:
    type: phandle-array
    required: false
    description: GPIO pin for reset signal
```

## pim447/dts/bindings/behaviors/zmk,behavior-pim447.yaml
```yaml
description: PIM447 custom behavior for ZMK
compatible: "zmk,behavior-pim447"
include: two_param.yaml
```

## west.yml
```yaml
manifest:
  remotes:
    - name: zmkfirmware
      url-base: https://github.com/zmkfirmware
    - name: pim
      url-base: https://github.com/t0bybr    # repo del driver PIM447
  projects:
    - name: zmk
      remote: zmkfirmware
      revision: main
      import: app/west.yml
    - name: pim447
      remote: pim
      revision: main
  self:
    path: config
```

## zmk/app/dts/bindings/sensor/pimoroni,trackball_pim447.yaml
```yaml
description: Pimoroni PIM447 I2C trackball

compatible: "pimoroni,trackball_pim447"

include: [i2c-device.yaml]

properties:
  mode:
    type: int
    required: false
    description: |
      Operating mode
      0 = PIM447_MOVE (pointer mode, default)
      1 = PIM447_SCROLL (scroll mode)
    enum:
      - 0
      - 1

  invert-move-x:
    type: boolean
    description: Invert X axis for pointer movement
  invert-move-y:
    type: boolean
    description: Invert Y axis for pointer movement
  invert-scroll-x:
    type: boolean
    description: Invert X axis for scroll
  invert-scroll-y:
    type: boolean
    description: Invert Y axis for scroll
  swap-axes:
    type: boolean
    description: Swap X and Y axes
  move-factor:
    type: int
    description: Multiplier for pointer speed (default 1)
  scroll-divisor:
    type: int
    description: Divider for scroll speed (default 2)
  button:
    type: int
    description: Mouse button number generated by ball press (0 = left, 1 = right, etc.)
```
